## conf/distro/poky-sota-systemd-wireless.conf
```bitbake
require conf/distro/poky.conf

require conf/distro/sota.conf.inc

DISTRO = "poky-sota"
DISTRO_NAME = "OTA-enabled Linux"
DISTRO_VERSION = "1.0"
DISTRO_CODENAME = "sota"

DISTRO_FEATURES_append = " systemd"
VIRTUAL-RUNTIME_init_manager = "systemd"

# tools added
# haveged rng-tools: add more randomization sources
# wpa-supplicant wireless-regdb crda iw: for wireless support

IMAGE_INSTALL_append = " haveged rng-tools wpa-supplicant wireless-regdb crda iw"
```
